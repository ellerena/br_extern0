## Config.in
```kconfig
source "$BR2_EXTERNAL_BREXT0_PATH/package/arty_pmod/Config.in"
source "$BR2_EXTERNAL_BREXT0_PATH/package/cora_br/Config.in"
source "$BR2_EXTERNAL_BREXT0_PATH/package/common/Config.in"
```

## board/coraz7/uboot_zynq_coraz7_defconfig
```kconfig
CONFIG_ARM=y
CONFIG_ARCH_ZYNQ=y
CONFIG_SYS_TEXT_BASE=0x4000000
CONFIG_SPL=y
CONFIG_DEBUG_UART_BASE=0xe0000000
CONFIG_DEBUG_UART_CLOCK=50000000
CONFIG_IDENT_STRING=" Xilinx Zynq Cora Z7"
CONFIG_SPL_STACK_R_ADDR=0x200000
CONFIG_DEBUG_UART=y
CONFIG_DISTRO_DEFAULTS=y
CONFIG_FIT=y
CONFIG_FIT_SIGNATURE=y
CONFIG_FIT_VERBOSE=y
CONFIG_IMAGE_FORMAT_LEGACY=y
CONFIG_BOOTDELAY=1
# CONFIG_USE_BOOTCOMMAND is not set
# CONFIG_DISPLAY_CPUINFO is not set
CONFIG_SPL_STACK_R=y
CONFIG_SPL_OS_BOOT=y
CONFIG_SPL_SPI_LOAD=y
CONFIG_SYS_PROMPT="Z7> "
CONFIG_CMD_MEMTEST=y
# CONFIG_CMD_FLASH is not set
CONFIG_CMD_FPGA_LOADBP=y
CONFIG_CMD_FPGA_LOADFS=y
CONFIG_CMD_FPGA_LOADMK=y
CONFIG_CMD_FPGA_LOADP=y
CONFIG_CMD_GPIO=y
CONFIG_CMD_I2C=y
CONFIG_CMD_MMC=y
CONFIG_CMD_SF=y
# CONFIG_CMD_SETEXPR is not set
CONFIG_CMD_CACHE=y
CONFIG_CMD_EXT4_WRITE=y
CONFIG_OF_EMBED=y
CONFIG_DEFAULT_DEVICE_TREE="zynq-coraz7"
CONFIG_ENV_IS_IN_SPI_FLASH=y
# CONFIG_NET is not set
CONFIG_SPL_DM_SEQ_ALIAS=y
CONFIG_FPGA_XILINX=y
CONFIG_FPGA_ZYNQPL=y
CONFIG_DM_GPIO=y
CONFIG_DM_I2C=y
CONFIG_SYS_I2C_CADENCE=y
CONFIG_LED=y
CONFIG_LED_GPIO=y
CONFIG_MISC=y
CONFIG_I2C_EEPROM=y
CONFIG_SYS_I2C_EEPROM_ADDR=0x0
CONFIG_SYS_I2C_EEPROM_ADDR_OVERFLOW=0x0
CONFIG_MMC_SDHCI=y
CONFIG_MMC_SDHCI_ZYNQ=y
CONFIG_SPI_FLASH=y
CONFIG_SPI_FLASH_BAR=y
CONFIG_SF_DUAL_FLASH=y
CONFIG_SPI_FLASH_ISSI=y
CONFIG_SPI_FLASH_MACRONIX=y
CONFIG_SPI_FLASH_SPANSION=y
CONFIG_SPI_FLASH_STMICRO=y
CONFIG_SPI_FLASH_WINBOND=y
CONFIG_DM_ETH=y
CONFIG_DEBUG_UART_ZYNQ=y
CONFIG_ZYNQ_SERIAL=y
CONFIG_ZYNQ_QSPI=y
CONFIG_REGEX=y
####Unique from zc702
CONFIG_SYS_CONFIG_NAME=zynq_common
CONFIG_SYS_NO_FLASH=y
CONFIG_SYS_MALLOC_F_LEN=0x800
# CONFIG_DISPLAY_CPUINFO is not set
CONFIG_HUSH_PARSER=y
CONFIG_CMD_BOOTZ=y
# CONFIG_CMD_IMLS is not set
CONFIG_CMD_DHCP=y
CONFIG_CMD_MII=y
CONFIG_CMD_PING=y
CONFIG_CMD_EXT2=y
CONFIG_CMD_EXT4=y
CONFIG_CMD_FAT=y
CONFIG_CMD_FS_GENERIC=y
CONFIG_DM_MMC=y
CONFIG_ZYNQ_SDHCI=y
CONFIG_DM_ETH=y
####CONFIG_G_DNL_MANUFACTURER=Xilinx
####CONFIG_G_DNL_VENDOR_NUM=0x03fd
####CONFIG_G_DNL_PRODUCT_NUM=0x0300
```

## configs/_atmel_sama5d3xek_defconfig
```kconfig
BR2_arm=y
BR2_cortex_a5=y
BR2_ARM_ENABLE_VFP=y
BR2_ARM_INSTRUCTIONS_THUMB2=y
BR2_TOOLCHAIN_BUILDROOT_GLIBC=y
BR2_PACKAGE_HOST_LINUX_HEADERS_CUSTOM_4_4=y
BR2_TARGET_GENERIC_HOSTNAME="sama5d31_buildroot"
BR2_TARGET_GENERIC_ISSUE="Elle - Atmel Sama5d3x-Ek Lnx"
BR2_TARGET_GENERIC_ROOT_PASSWD="root"
BR2_SYSTEM_DHCP="eth0"
BR2_ROOTFS_OVERLAY="$(BR2_EXTERNAL_BREXT0_PATH)/board/sama5d3xek/busybox_ovly"
BR2_LINUX_KERNEL=y
BR2_LINUX_KERNEL_CUSTOM_GIT=y
BR2_LINUX_KERNEL_CUSTOM_REPO_URL="https://github.com/linux4sam/linux-at91.git"
BR2_LINUX_KERNEL_CUSTOM_REPO_VERSION="linux4sam_5.5"
BR2_LINUX_KERNEL_DEFCONFIG="sama5"
BR2_LINUX_KERNEL_DTS_SUPPORT=y
BR2_LINUX_KERNEL_INTREE_DTS_NAME="sama5d31ek"
BR2_PACKAGE_LUA=y
BR2_PACKAGE_PYTHON=y
BR2_PACKAGE_PYTHON_SOCKETIO=y
BR2_PACKAGE_OPENSSL=y
BR2_PACKAGE_APR_UTIL=y
BR2_PACKAGE_PCRE=y
BR2_PACKAGE_DROPBEAR=y
BR2_PACKAGE_XINETD=y
# BR2_TARGET_ROOTFS_TAR is not set
BR2_TARGET_ROOTFS_UBI=y
BR2_TARGET_ROOTFS_UBI_SUBSIZE=2048
BR2_TARGET_ROOTFS_UBIFS_LEBSIZE=0x1f000
BR2_TARGET_AT91BOOTSTRAP3=y
BR2_TARGET_AT91BOOTSTRAP3_CUSTOM_GIT=y
BR2_TARGET_AT91BOOTSTRAP3_CUSTOM_REPO_URL="https://github.com/linux4sam/at91bootstrap.git"
BR2_TARGET_AT91BOOTSTRAP3_CUSTOM_REPO_VERSION="v3.8.7"
BR2_TARGET_AT91BOOTSTRAP3_DEFCONFIG="sama5d3xeknf_uboot"
BR2_TARGET_UBOOT=y
BR2_TARGET_UBOOT_BUILD_SYSTEM_KCONFIG=y
BR2_TARGET_UBOOT_CUSTOM_GIT=y
BR2_TARGET_UBOOT_CUSTOM_REPO_URL="https://github.com/linux4sam/u-boot-at91.git"
BR2_TARGET_UBOOT_CUSTOM_REPO_VERSION="linux4sam_5.5"
BR2_TARGET_UBOOT_BOARD_DEFCONFIG="sama5d3xek_nandflash"
BR2_TARGET_UBOOT_SPL=y
BR2_PACKAGE_HOST_SAM_BA=y
```

## configs/artylnx_busybox_defconfig
```kconfig
#BR2_GLOBAL_PATCH_DIR=$(BR2_EXTERNAL_BREXT0_PATH)/patches/
BR2_microblazeel=y
BR2_TOOLCHAIN_BUILDROOT_GLIBC=y
BR2_BINUTILS_VERSION_2_30_X=y
BR2_ECLIPSE_REGISTER=y
BR2_TARGET_GENERIC_HOSTNAME="Arty7Lnx"
BR2_TARGET_GENERIC_ISSUE="Welcome to Arty 7 uBlaze Lnx Busybox"
BR2_TARGET_GENERIC_ROOT_PASSWD="root"
BR2_TARGET_GENERIC_GETTY_PORT="ttyUL0"
BR2_TARGET_GENERIC_GETTY_BAUDRATE_115200=y
BR2_SYSTEM_DHCP="eth0"
BR2_TARGET_TZ_INFO=y
BR2_TARGET_TZ_ZONELIST="northamerica"
BR2_TARGET_LOCALTIME="America/New_York"
BR2_ROOTFS_OVERLAY="$(BR2_EXTERNAL_BREXT0_PATH)/board/arty/busybox_ovly $(BR2_EXTERNAL_BREXT0_PATH)/board/common/busybox_ovly"
BR2_LINUX_KERNEL=y
BR2_LINUX_KERNEL_CUSTOM_TARBALL=y
BR2_LINUX_KERNEL_CUSTOM_TARBALL_LOCATION="file:///$(TOPDIR)/../linux-4.15.tar.gz"
BR2_LINUX_KERNEL_USE_CUSTOM_CONFIG=y
BR2_LINUX_KERNEL_CUSTOM_CONFIG_FILE="$(BR2_EXTERNAL_BREXT0_PATH)/board/arty/artylnx_cnf_defconfig"
BR2_LINUX_KERNEL_CUSTOM_DTS_PATH="$(BR2_EXTERNAL_BREXT0_PATH)/board/arty/arty_lnx_pmod.dts"
BR2_PACKAGE_BUSYBOX_CONFIG="$(BR2_EXTERNAL_BREXT0_PATH)/board/arty/busybox.config"
BR2_PACKAGE_LUA=y
BR2_PACKAGE_ARGPARSE=y
BR2_PACKAGE_CGILUA=y
BR2_PACKAGE_MICROPYTHON=y
BR2_PACKAGE_MICROPYTHON_LIB=y
BR2_PACKAGE_OPENSSL=y
BR2_PACKAGE_EXPAT=y
BR2_PACKAGE_LIBEVENT=y
BR2_PACKAGE_NCURSES=y
BR2_PACKAGE_DROPBEAR=y
BR2_TARGET_ROOTFS_INITRAMFS=y
# BR2_TARGET_ROOTFS_TAR is not set
BR2_PACKAGE_ARTY_PMOD=y
BR2_PACKAGE_COMMON=y
```

## configs/coraz7lnx_defconfig
```kconfig
BR2_arm=y
BR2_cortex_a9=y
BR2_ARM_ENABLE_NEON=y
BR2_ARM_ENABLE_VFP=y
BR2_TOOLCHAIN_BUILDROOT_GLIBC=y
BR2_KERNEL_HEADERS_4_19=y
BR2_TARGET_GENERIC_HOSTNAME="zynqbr_coraz7"
BR2_TARGET_GENERIC_ISSUE="Paris et libere!"
BR2_TARGET_GENERIC_GETTY_PORT="ttyPS0"
BR2_ROOTFS_OVERLAY="$(BR2_EXTERNAL_BREXT0_PATH)/board/coraz7/busybox_ovly $(BR2_EXTERNAL_BREXT0_PATH)/board/common/busybox_ovly"
BR2_LINUX_KERNEL=y
BR2_LINUX_KERNEL_CUSTOM_TARBALL=y
BR2_LINUX_KERNEL_CUSTOM_TARBALL_LOCATION="file:///$(TOPDIR)/../linux-xlnx-xilinx-v2019.1.tar.gz"
BR2_LINUX_KERNEL_DEFCONFIG="xilinx_zynq"
BR2_LINUX_KERNEL_UIMAGE=y
BR2_LINUX_KERNEL_UIMAGE_LOADADDR="0x8000"
BR2_LINUX_KERNEL_DTS_SUPPORT=y
BR2_LINUX_KERNEL_CUSTOM_DTS_PATH="$(BR2_EXTERNAL_BREXT0_PATH)/board/coraz7/zynq-coraz7.dts "
BR2_PACKAGE_PYTHON3=y
BR2_PACKAGE_DROPBEAR=y
BR2_PACKAGE_LIGHTTPD=y
BR2_TARGET_ROOTFS_CPIO_GZIP=y
BR2_TARGET_ROOTFS_INITRAMFS=y
# BR2_TARGET_ROOTFS_TAR is not set
BR2_TARGET_UBOOT=y
BR2_TARGET_UBOOT_BUILD_SYSTEM_KCONFIG=y
BR2_TARGET_UBOOT_CUSTOM_TARBALL=y
BR2_TARGET_UBOOT_CUSTOM_TARBALL_LOCATION="file:///$(TOPDIR)/../u-boot-xlnx-xilinx-v2019.1.tar.gz"
BR2_TARGET_UBOOT_USE_CUSTOM_CONFIG=y
BR2_TARGET_UBOOT_CUSTOM_CONFIG_FILE="$(BR2_EXTERNAL_BREXT0_PATH)/board/coraz7/uboot_zynq_coraz7_defconfig"
# BR2_TARGET_UBOOT_FORMAT_BIN is not set
BR2_TARGET_UBOOT_FORMAT_ELF=y
BR2_TARGET_UBOOT_CUSTOM_DTS_PATH="$(BR2_EXTERNAL_BREXT0_PATH)/board/coraz7/zynq-coraz7.dts"
BR2_PACKAGE_CORA_BR=y
BR2_PACKAGE_COMMON=y
```

## package/arty_pmod/Config.in
```kconfig
config BR2_PACKAGE_ARTY_PMOD
	bool "arty pmod module - brext0"
	depends on BR2_LINUX_KERNEL
	help
		This is the Arty Pmod Capture Module - BREXT0
```

## package/common/Config.in
```kconfig
config BR2_PACKAGE_COMMON
	bool "common tools for boards - brext2"
#	depends on BR2_LINUX_KERNEL
	help
		Some common tools for all boards - BREXT2
```

## package/cora_br/Config.in
```kconfig
config BR2_PACKAGE_CORA_BR
	bool "cora z7 info module - brext1"
	depends on BR2_LINUX_KERNEL
	help
		This is the Cora-z7 Info Module - BREXT1
```
